// These arguments were used when this file was generated. They will be automatically applied on subsequent loads 
// via the GUI or CLI invocations. Run CLI with '--help' for additional information on how to override these arguments.
// @cliArgs --device "CC3200" --package "Default" --part "Default" --product "CLB Configuration Tool@1.0.0"
// @versions {"data":"2019051709","timestamp":"2019051709","tool":"1.1.792","templates":"2019051709"}

var TILE = scripting.addModule("/utilities/clb_tool/clb_syscfg/source/TILE");
var TILE1 = TILE.addInstance();
// Name
TILE1.$name = "TILE1";
// Name
TILE1.BOUNDARY.$name = "BOUNDARY0";
// in_repeat_count0 - Number of periods the waveform is repeated
TILE1.BOUNDARY.in_repeat_count0 = 0;
// in0
TILE1.BOUNDARY.in0 = "1";
// in1
TILE1.BOUNDARY.in1 = "0";
// Name
TILE1.LUT_0.$name = "LUT_0";
// eqn - Boolean equation on the variables i3,i2,i1,i0 for the LUT output.
TILE1.LUT_0.eqn = "(i0&(!i2))|((!i0)&i1)";
// i0 - Input 0.
TILE1.LUT_0.i0 = "BOUNDARY.in6";
// i1 - Input 1.
TILE1.LUT_0.i1 = "BOUNDARY.in1";
// i2 - Input 2.
TILE1.LUT_0.i2 = "BOUNDARY.in3";
// Name
TILE1.LUT_1.$name = "LUT_1";
// i0 - Input 0.
TILE1.LUT_1.i0 = "FSM_0.S0";
// i2 - Input 2.
TILE1.LUT_1.i2 = "FSM_2.S0";
// i1 - Input 1.
TILE1.LUT_1.i1 = "FSM_1.S0";
// eqn - Boolean equation on the variables i3,i2,i1,i0 for the LUT output.
TILE1.LUT_1.eqn = "i0|i2";
// Name
TILE1.LUT_2.$name = "LUT_2";
// eqn - Boolean equation on the variables i3,i2,i1,i0 for the LUT output.
TILE1.LUT_2.eqn = "i0|i1|i2";
// i0 - Input 0.
TILE1.LUT_2.i0 = "FSM_0.S0";
// i1 - Input 1.
TILE1.LUT_2.i1 = "FSM_1.S0";
// i2 - Input 2.
TILE1.LUT_2.i2 = "FSM_2.S0";
// Name
TILE1.FSM_0.$name = "FSM_0";
// e1 - External Input 1.
TILE1.FSM_0.e1 = "COUNTER_0.count_match1";
// e0 - External Input 0.
TILE1.FSM_0.e0 = "LUT_0.OUT";
// eqn_s0 - Boolean equation on the variables e1,e0,s1,s0 for the S0 output.
TILE1.FSM_0.eqn_s0 = "(((!e0)&(!e1)&s0)|((e0)&(!e1)&(!s0))|(e0&(!e1)&s0))";
// eqn_out - Boolean equation on the variables e1,e0,s1,s0 for the LUT output.
TILE1.FSM_0.eqn_out = "~s0";
// Name
TILE1.FSM_1.$name = "FSM_1";
// e0 - External Input 0.
TILE1.FSM_1.e0 = "COUNTER_0.count_match1";
// e1 - External Input 1.
TILE1.FSM_1.e1 = "BOUNDARY.in7";
// eqn_s0 - Boolean equation on the variables e1,e0,s1,s0 for the S0 output.
TILE1.FSM_1.eqn_s0 = "(((!e0)&(!e1)&s0)|((e0)&(!e1)&(!s0))|(e0&(!e1)&s0))";
// Name
TILE1.FSM_2.$name = "FSM_2";
// eqn_s0 - Boolean equation on the variables e1,e0,s1,s0 for the S0 output.
TILE1.FSM_2.eqn_s0 = "(((!e0)&(!e1)&s0)|((e0)&(!e1)&(!s0))|(e0&(!e1)&s0))";
// e0 - External Input 0.
TILE1.FSM_2.e0 = "BOUNDARY.in7";
// e1 - External Input 1.
TILE1.FSM_2.e1 = "COUNTER_1.count_match1";
// eqn_out - Boolean equation on the variables e1,e0,s1,s0 for the LUT output.
TILE1.FSM_2.eqn_out = "~s0";
// Name
TILE1.COUNTER_0.$name = "COUNTER_0";
// match1_val - Sets the value of the Match reference 1 register.
TILE1.COUNTER_0.match1_val = "670";
// reset - Reset the counter to 0 on next clock cycle (triggers low to high)
TILE1.COUNTER_0.reset = "COUNTER_0.count_match1";
// mode1 - Controls counting direction. High enables count up. Low enables count down.
TILE1.COUNTER_0.mode1 = "1";
// mode0 - Enables Counting when high
TILE1.COUNTER_0.mode0 = "FSM_0.S0";
// Name
TILE1.COUNTER_1.$name = "COUNTER_1";
// match2_val - Sets the value of the Match reference 2 register.
TILE1.COUNTER_1.match2_val = "";
// reset - Reset the counter to 0 on next clock cycle (triggers low to high)
TILE1.COUNTER_1.reset = "COUNTER_1.count_match1";
// mode1 - Controls counting direction. High enables count up. Low enables count down.
TILE1.COUNTER_1.mode1 = "1";
// mode0 - Enables Counting when high
TILE1.COUNTER_1.mode0 = "FSM_2.S0";
// match1_val - Sets the value of the Match reference 1 register.
TILE1.COUNTER_1.match1_val = "670";
// Name
TILE1.COUNTER_2.$name = "COUNTER_2";
// Name
TILE1.OUTLUT_0.$name = "OUTLUT_0";
// eqn - Boolean equation on the variables i2,i1,i0 for the OUTLUT output.
TILE1.OUTLUT_0.eqn = "((!i1)&i0)|((i1)&i2)";
// i2 - Input 2.
TILE1.OUTLUT_0.i2 = "BOUNDARY.in2";
// i0 - Input 0.
TILE1.OUTLUT_0.i0 = "BOUNDARY.in0";
// i1 - Input 1.
TILE1.OUTLUT_0.i1 = "LUT_2.OUT";
// Name
TILE1.OUTLUT_1.$name = "OUTLUT_1";
// eqn - Boolean equation on the variables i2,i1,i0 for the OUTLUT output.
TILE1.OUTLUT_1.eqn = "0";
// Name
TILE1.OUTLUT_2.$name = "OUTLUT_2";
// i1 - Input 1.
TILE1.OUTLUT_2.i1 = "LUT_1.OUT";
// i0 - Input 0.
TILE1.OUTLUT_2.i0 = "BOUNDARY.in1";
// eqn - Boolean equation on the variables i2,i1,i0 for the OUTLUT output.
TILE1.OUTLUT_2.eqn = "(i1&i2)|((!i1)&i0)";
// i2 - Input 2.
TILE1.OUTLUT_2.i2 = "BOUNDARY.in3";
// Name
TILE1.OUTLUT_3.$name = "OUTLUT_3";
// Name
TILE1.OUTLUT_4.$name = "OUTLUT_4";
// i0 - Input 0.
TILE1.OUTLUT_4.i0 = "FSM_0.S0";
// eqn - Boolean equation on the variables i2,i1,i0 for the OUTLUT output.
TILE1.OUTLUT_4.eqn = "i0";
// Name
TILE1.OUTLUT_5.$name = "OUTLUT_5";
// i0 - Input 0.
TILE1.OUTLUT_5.i0 = "FSM_0.OUT";
// i1 - Input 1.
TILE1.OUTLUT_5.i1 = "FSM_1.OUT";
// eqn - Boolean equation on the variables i2,i1,i0 for the OUTLUT output.
TILE1.OUTLUT_5.eqn = "i0|i1";
// Name
TILE1.OUTLUT_6.$name = "OUTLUT_6";
// Name
TILE1.OUTLUT_7.$name = "OUTLUT_7";
// Name
TILE1.HLC.$name = "HLC_0";
// Name
TILE1.HLC.program0.$name = "HLCP_0";
// Name
TILE1.HLC.program1.$name = "HLCP_1";
// Name
TILE1.HLC.program2.$name = "HLCP_2";
// Name
TILE1.HLC.program3.$name = "HLCP_3";
var clb_run_dynamic_template_clb_h = scripting.addModule("/utilities/clb_tool/clb_syscfg/source/clb_run_dynamic_template_clb_h.js");
var clb_run_dynamic_template_clb_c = scripting.addModule("/utilities/clb_tool/clb_syscfg/source/clb_run_dynamic_template_clb_c.js");
var clb_run_dynamic_template_clb_sim = scripting.addModule("/utilities/clb_tool/clb_syscfg/source/clb_run_dynamic_template_clb_sim.js");
var clb_run_dynamic_template_clb_dot = scripting.addModule("/utilities/clb_tool/clb_syscfg/source/clb_run_dynamic_template_clb_dot.js");
